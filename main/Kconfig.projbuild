## main/Kconfig.projbuild
```kconfig
menu "Application Configuration"

config APP_WIFI_SSID
    string "WiFi SSID"
    default "myssid"
    help
    SSID (network name) for the example to connect to.

config APP_WIFI_PASSWORD
    string "WiFi Password"
    default "mypassword"
    help
    WiFi password (WPA or WPA2) for the example to use.

config APP_CURRENCY_API_KEY
    string "APILayer key"

config APP_LED_BRIGHTNESS
	int "Brightness of the LED display"
	range 1 15
	default 10

config APP_AMOUNT_OF_DOLLARS
	int "Amount of dollars you have"
	default 50

endmenu
```
